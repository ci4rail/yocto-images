## kas-includes/meta-oss-compliance/conf/layer.conf
```bitbake
BBPATH .= ":${LAYERDIR}"
BBFILES += "${LAYERDIR}/recipes-*/*/*.bbappend"

BBFILE_COLLECTIONS += "oss-compliance"
BBFILE_PATTERN_oss-compliance = "^${LAYERDIR}/"
BBFILE_PRIORITY_oss-compliance = "99"
LAYERDEPENDS_oss-compliance = "core"
LAYERSERIES_COMPAT_oss-compliance = "scarthgap"
```

## testfarm-recovery/meta-testfarm-recovery/conf/layer.conf
```bitbake
BBPATH .= ":${LAYERDIR}"
BBFILES += "${LAYERDIR}/recipes-*/*/*.bbappend"
BBFILE_COLLECTIONS += "testfarm-recovery"
BBFILE_PATTERN_testfarm-recovery = "^${LAYERDIR}/"
BBFILE_PRIORITY_testfarm-recovery = "99"
LAYERSERIES_COMPAT_testfarm-recovery = "scarthgap"
```
